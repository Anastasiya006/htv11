## gemware/gemware/main/Kconfig.projbuild
```kconfig
menu "Example Configuration"

    config ESP_WIFI_SSID
        string "WiFi SSID"
        default "myssid"
        help
            SSID (network name) for the example to connect to.

    config ESP_WIFI_PASSWORD
        string "WiFi Password"
        default "mypassword"
        help
            WiFi password (WPA or WPA2) for the example to use.

    choice ESP_WIFI_SAE_MODE
        prompt "WPA3 SAE mode selection"
        default ESP_STATION_EXAMPLE_WPA3_SAE_PWE_BOTH
        help
            Select mode for SAE as Hunt and Peck, H2E or both.
        config ESP_STATION_EXAMPLE_WPA3_SAE_PWE_HUNT_AND_PECK
            bool "HUNT AND PECK"
        config ESP_STATION_EXAMPLE_WPA3_SAE_PWE_HASH_TO_ELEMENT
            bool "H2E"
            depends on ESP_WIFI_ENABLE_SAE_H2E
        config ESP_STATION_EXAMPLE_WPA3_SAE_PWE_BOTH
            bool "BOTH"
            depends on ESP_WIFI_ENABLE_SAE_H2E
    endchoice

    config ESP_WIFI_PW_ID
        string "PASSWORD IDENTIFIER"
        depends on  ESP_STATION_EXAMPLE_WPA3_SAE_PWE_HASH_TO_ELEMENT|| ESP_STATION_EXAMPLE_WPA3_SAE_PWE_BOTH
        default ""
        help
            password identifier for SAE H2E

    config ESP_MAXIMUM_RETRY
        int "Maximum retry"
        default 5
        help
            Set the Maximum retry to avoid station reconnecting to the AP unlimited when the AP is really inexistent.

    choice ESP_WIFI_SCAN_AUTH_MODE_THRESHOLD
        prompt "WiFi Scan auth mode threshold"
        default ESP_WIFI_AUTH_WPA2_PSK
        help
            The weakest authmode to accept in the scan mode.
            This value defaults to ESP_WIFI_AUTH_WPA2_PSK in case password is present and ESP_WIFI_AUTH_OPEN is used.
            Please select ESP_WIFI_AUTH_WEP/ESP_WIFI_AUTH_WPA_PSK in case AP is operating in WEP/WPA mode.

        config ESP_WIFI_AUTH_OPEN
            bool "OPEN"
        config ESP_WIFI_AUTH_WEP
            bool "WEP"
        config ESP_WIFI_AUTH_WPA_PSK
            bool "WPA PSK"
        config ESP_WIFI_AUTH_WPA2_PSK
            bool "WPA2 PSK"
        config ESP_WIFI_AUTH_WPA_WPA2_PSK
            bool "WPA/WPA2 PSK"
        config ESP_WIFI_AUTH_WPA3_PSK
            bool "WPA3 PSK"
        config ESP_WIFI_AUTH_WPA2_WPA3_PSK
            bool "WPA2/WPA3 PSK"
        config ESP_WIFI_AUTH_WAPI_PSK
            bool "WAPI PSK"
    endchoice

endmenu

menu "Gemmi Wi-Fi"

config GEMMI_WIFI_ENTERPRISE
    bool "Use WPA2-Enterprise (eduroam)"
    default n
    help
        Use an EAP username and password instead of the normal WPA/WPA2
        pre-shared-key connection. Leave disabled for ordinary home Wi-Fi.

if GEMMI_WIFI_ENTERPRISE

choice GEMMI_WIFI_EAP_METHOD
    prompt "EAP method"
    default GEMMI_WIFI_EAP_PEAP
    help
        PEAP with MSCHAPv2 is common on eduroam. Select TTLS only when
        your institution's eduroam instructions explicitly specify it.

    config GEMMI_WIFI_EAP_PEAP
        bool "PEAP (usually MSCHAPv2)"

    config GEMMI_WIFI_EAP_TTLS
        bool "TTLS"
endchoice

if GEMMI_WIFI_EAP_TTLS

choice GEMMI_WIFI_TTLS_PHASE2
    prompt "TTLS inner authentication"
    default GEMMI_WIFI_TTLS_MSCHAPV2

    config GEMMI_WIFI_TTLS_MSCHAPV2
        bool "MSCHAPv2"

    config GEMMI_WIFI_TTLS_PAP
        bool "PAP"
endchoice

endif

config GEMMI_WIFI_EAP_IDENTITY
    string "Outer identity"
    default ""
    help
        Usually your full eduroam identity, for example username@school.edu.
        Follow your institution's eduroam instructions exactly.

config GEMMI_WIFI_EAP_USERNAME
    string "Inner username"
    default ""
    help
        Often the same as the outer identity. Some institutions require only
        the local username here.

config GEMMI_WIFI_EAP_PASSWORD
    string "EAP password"
    default ""
    help
        Saved only to this machine's ignored sdkconfig file. Do not commit or
        share this file.

config GEMMI_WIFI_EAP_DOMAIN
    string "Server certificate domain (recommended)"
    default ""
    help
        The expected RADIUS server certificate name, when supplied by your
        institution. Leaving it blank still verifies against the ESP-IDF CA
        bundle, but pinning the stated domain is stronger.

endif

endmenu

menu "Gemmi bridge"

config GEMMI_BRIDGE_URL
    string "Computer-side Gemmi bridge URL"
    default "http://192.168.1.2:8732"
    help
        The LAN URL printed by `gemmi serve`. This must be the computer's
        reachable IPv4 address, not localhost. Configure it before flashing.

config GEMMI_BRIDGE_REQUIRE_TLS
    bool "Require HTTPS and certificate validation"
    default n
    help
        Enable this for any public tunnel. Gemware will refuse an http:// URL
        and verifies the server certificate using the ESP-IDF CA bundle.

config GEMMI_BRIDGE_TOKEN
    string "Bridge access token"
    default ""
    help
        Required for a public tunnel. Keep this secret in the ignored local
        sdkconfig file. Do not use a short password: use the token generated
        by `gemmi tunnel init`.

config GEMMI_BRIDGE_REQUIRE_TOKEN
    bool "Require a bridge access token"
    default n
    help
        Refuse to connect if the bridge token is empty. Enable with any public
        tunnel so Gemware fails closed after a configuration mistake.

config GEMMI_DEVICE_ID
    string "Gemmi device identifier"
    default "gemmi-esp32"
    help
        A short name included in device requests. Future bridge versions use
        this to target queues to a specific device.

endmenu
```

## gemware/gemware/sdkconfig.defaults
```kconfig
CONFIG_ESP_WIFI_SOFTAP_SUPPORT=n
CONFIG_LV_USE_CLIB_MALLOC=y
CONFIG_LV_USE_GIF=y
CONFIG_LV_DRAW_SW_SUPPORT_RGB565_SWAPPED=y
CONFIG_PARTITION_TABLE_CUSTOM=y
CONFIG_PARTITION_TABLE_CUSTOM_FILENAME="partitions_gemware.csv"
CONFIG_GEMMI_BRIDGE_URL="http://192.168.1.2:8732"
CONFIG_GEMMI_DEVICE_ID="gemmi-esp32"

CONFIG_LV_FONT_UNSCII_8=y
CONFIG_LV_FONT_MONTSERRAT_12=y
```
